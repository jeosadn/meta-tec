## conf/bblayers.conf
```bitbake
# POKY_BBLAYERS_CONF_VERSION is increased each time build/conf/bblayers.conf
# changes incompatibly
POKY_BBLAYERS_CONF_VERSION = "2"

BBPATH = "${TOPDIR}"
BBFILES ?= ""

BBLAYERS ?= " \
  ${HOME}/rendimiento/g6_hpes_2019/assignment1/poky/meta \
  ${HOME}/rendimiento/g6_hpes_2019/assignment1/poky/meta-poky \
  ${HOME}/rendimiento/g6_hpes_2019/assignment1/poky/meta-openembedded/meta-oe \
  ${HOME}/rendimiento/g6_hpes_2019/assignment1/poky/meta-openembedded/meta-multimedia \
  ${HOME}/rendimiento/g6_hpes_2019/assignment1/poky/meta-openembedded/meta-networking \
  ${HOME}/rendimiento/g6_hpes_2019/assignment1/poky/meta-openembedded/meta-perl \
  ${HOME}/rendimiento/g6_hpes_2019/assignment1/poky/meta-openembedded/meta-python \
  ${HOME}/rendimiento/g6_hpes_2019/assignment1/poky/meta-qt5 \
  ${HOME}/rendimiento/g6_hpes_2019/assignment1/poky/meta-raspberrypi \
  ${HOME}/rendimiento/g6_hpes_2019/assignment1/poky/meta-rpi \
  /home/jo/meta-tec/meta-tec \
  "
```
